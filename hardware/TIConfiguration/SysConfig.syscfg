/**
 * @cliArgs --device "AM335x" --part "AM3358-ZCZ" --package "ZCZ"
 * @versions {"tool":"1.22.0+3893"}
 */

/**
 * These are the peripherals and settings in this configuration
 */
const iDEBUGSS1                 = scripting.addPeripheral("DEBUGSS");
iDEBUGSS1.$useCase              = "DEBUGSS_1";
iDEBUGSS1.$name                 = "JTAG";
const iEMIF1                    = scripting.addPeripheral("EMIF");
iEMIF1.$useCase                 = "EMIF_3";
iEMIF1.$name                    = "EMIF4_DDR3L";
const iGLUE1                    = scripting.addPeripheral("GLUE");
iGLUE1.$useCase                 = "GLUE_1";
iGLUE1.$name                    = "GLUE";
iGLUE1.xdma_event_intr0.$assign = "xdma_event_intr0";
iGLUE1.xdma_event_intr0.$used   = true;
iGLUE1.clkout2.$assign          = "xdma_event_intr1";
iGLUE1.clkout2.$used            = true;
const iGPIO1                    = scripting.addPeripheral("GPIO");
iGPIO1.$useCase                 = "GPIO_1";
iGPIO1.$name                    = "MyGPIO0";
iGPIO1.$assign                  = "GPIO0";
iGPIO1["gpio[7]"].$used         = true;
iGPIO1["gpio[12]"].$used        = true;
iGPIO1["gpio[13]"].$used        = true;
iGPIO1["gpio[26]"].$used        = true;
iGPIO1["gpio[27]"].$used        = true;
iGPIO1["gpio[29]"].$assign      = "rmii1_refclk";
iGPIO1["gpio[29]"].$used        = true;
iGPIO1["gpio[30]"].$used        = true;
iGPIO1["gpio[31]"].$used        = true;
const iGPIO2                    = scripting.addPeripheral("GPIO");
iGPIO2.$useCase                 = "GPIO_1";
iGPIO2.$name                    = "MyGPIO1";
iGPIO2["gpio[8]"].$used         = true;
iGPIO2["gpio[20]"].$assign      = "gpmc_a4";
iGPIO2["gpio[20]"].$used        = true;
const iI2C1                     = scripting.addPeripheral("I2C");
iI2C1.$useCase                  = "I2C_1";
iI2C1.$name                     = "I2C0_PMIC";
iI2C1.$assign                   = "I2C0";
const iI2C2                     = scripting.addPeripheral("I2C");
iI2C2.$useCase                  = "I2C_1";
iI2C2.$name                     = "GP_I2C1";
iI2C2.$assign                   = "I2C1";
const iMDIO1                    = scripting.addPeripheral("MDIO");
iMDIO1.$name                    = "MyMDIO1";
const iMII1                     = scripting.addPeripheral("MII");
iMII1.$useCase                  = "MII_1";
iMII1.$name                     = "GMII1";
iMII1.$assign                   = "GMII1";
const iMMC1                     = scripting.addPeripheral("MMC");
iMMC1.$useCase                  = "MMC_2";
iMMC1.$name                     = "MMC2_WiFi ";
iMMC1.$assign                   = "MMC2";
const iMMC2                     = scripting.addPeripheral("MMC");
iMMC2.$useCase                  = "MMC_5";
iMMC2.$name                     = "MMC1_EMMC";
const iMMC3                     = scripting.addPeripheral("MMC");
iMMC3.$useCase                  = "MMC_2";
iMMC3.$name                     = "MMC0_SDMMC";
iMMC3.$assign                   = "MMC0";
iMMC3.dat0.$assign              = "mmc0_dat0";
iMMC3.sdcd.$assign              = "spi0_cs1";
iMMC3.sdcd.$used                = true;
const iOSC1                     = scripting.addPeripheral("OSC");
iOSC1.$name                     = "OSC_32.768";
iOSC1.$assign                   = "OSC1";
const iOSC2                     = scripting.addPeripheral("OSC");
iOSC2.$name                     = "OSC_24MHZ";
const iSPI1                     = scripting.addPeripheral("SPI");
iSPI1.$useCase                  = "SPI_2";
iSPI1.$name                     = "GP_SPI1";
iSPI1.$assign                   = "SPI1";
iSPI1.$pinGroup.CS0.$assign     = "mcasp0_ahclkr";
iSPI1.$pinGroup.CS1.$used       = false;
const iUART1                    = scripting.addPeripheral("UART");
iUART1.$useCase                 = "UART_1";
iUART1.$name                    = "UART0";
iUART1.$assign                  = "UART0";
const iUART2                    = scripting.addPeripheral("UART");
iUART2.$useCase                 = "UART_1";
iUART2.$name                    = "UART1_F9P";
iUART2.$assign                  = "UART1";
const iUART3                    = scripting.addPeripheral("UART");
iUART3.$useCase                 = "UART_1";
iUART3.$name                    = "GP_UART2";
iUART3.$assign                  = "UART2";
const iUSB1                     = scripting.addPeripheral("USB");
iUSB1.$useCase                  = "USB_1";
iUSB1.$name                     = "USB0_LTE";
const iUSB2                     = scripting.addPeripheral("USB");
iUSB2.$useCase                  = "USB_1";
iUSB2.$name                     = "USB1_HUB";

/**
 * Pinmux solution for unlocked pins/peripherals. This ensures that minor changes to the automatic solver in a future
 * version of the tool will not impact the pinmux you originally saw.  These lines can be completely deleted in order to
 * re-solve from scratch.
 */
iDEBUGSS1.$suggestSolution          = "DEBUGSS";
iDEBUGSS1.TMS.$suggestSolution      = "TMS";
iDEBUGSS1.TDI.$suggestSolution      = "TDI";
iDEBUGSS1.TDO.$suggestSolution      = "TDO";
iDEBUGSS1.TCK.$suggestSolution      = "TCK";
iDEBUGSS1.nTRST.$suggestSolution    = "nTRST";
iDEBUGSS1.EMU0.$suggestSolution     = "EMU0";
iDEBUGSS1.EMU1.$suggestSolution     = "EMU1";
iEMIF1.$suggestSolution             = "EMIF4";
iEMIF1.resetn.$suggestSolution      = "ddr_resetn";
iEMIF1.csn0.$suggestSolution        = "ddr_csn0";
iEMIF1.ck.$suggestSolution          = "ddr_ck";
iEMIF1.nck.$suggestSolution         = "ddr_nck";
iEMIF1.casn.$suggestSolution        = "ddr_casn";
iEMIF1.rasn.$suggestSolution        = "ddr_rasn";
iEMIF1.wen.$suggestSolution         = "ddr_wen";
iEMIF1.ba0.$suggestSolution         = "ddr_ba0";
iEMIF1.ba1.$suggestSolution         = "ddr_ba1";
iEMIF1.ba2.$suggestSolution         = "ddr_ba2";
iEMIF1.a0.$suggestSolution          = "ddr_a0";
iEMIF1.a1.$suggestSolution          = "ddr_a1";
iEMIF1.a2.$suggestSolution          = "ddr_a2";
iEMIF1.a3.$suggestSolution          = "ddr_a3";
iEMIF1.a4.$suggestSolution          = "ddr_a4";
iEMIF1.a5.$suggestSolution          = "ddr_a5";
iEMIF1.a6.$suggestSolution          = "ddr_a6";
iEMIF1.a7.$suggestSolution          = "ddr_a7";
iEMIF1.a8.$suggestSolution          = "ddr_a8";
iEMIF1.a9.$suggestSolution          = "ddr_a9";
iEMIF1.a10.$suggestSolution         = "ddr_a10";
iEMIF1.a11.$suggestSolution         = "ddr_a11";
iEMIF1.a12.$suggestSolution         = "ddr_a12";
iEMIF1.a13.$suggestSolution         = "ddr_a13";
iEMIF1.a14.$suggestSolution         = "ddr_a14";
iEMIF1.a15.$suggestSolution         = "ddr_a15";
iEMIF1.d0.$suggestSolution          = "ddr_d0";
iEMIF1.d1.$suggestSolution          = "ddr_d1";
iEMIF1.d2.$suggestSolution          = "ddr_d2";
iEMIF1.d3.$suggestSolution          = "ddr_d3";
iEMIF1.d4.$suggestSolution          = "ddr_d4";
iEMIF1.d5.$suggestSolution          = "ddr_d5";
iEMIF1.d6.$suggestSolution          = "ddr_d6";
iEMIF1.d7.$suggestSolution          = "ddr_d7";
iEMIF1.d8.$suggestSolution          = "ddr_d8";
iEMIF1.d9.$suggestSolution          = "ddr_d9";
iEMIF1.d10.$suggestSolution         = "ddr_d10";
iEMIF1.d11.$suggestSolution         = "ddr_d11";
iEMIF1.d12.$suggestSolution         = "ddr_d12";
iEMIF1.d13.$suggestSolution         = "ddr_d13";
iEMIF1.d14.$suggestSolution         = "ddr_d14";
iEMIF1.d15.$suggestSolution         = "ddr_d15";
iEMIF1.dqm0.$suggestSolution        = "ddr_dqm0";
iEMIF1.dqm1.$suggestSolution        = "ddr_dqm1";
iEMIF1.dqs0.$suggestSolution        = "ddr_dqs0";
iEMIF1.dqsn0.$suggestSolution       = "ddr_dqsn0";
iEMIF1.dqs1.$suggestSolution        = "ddr_dqs1";
iEMIF1.dqsn1.$suggestSolution       = "ddr_dqsn1";
iEMIF1.vref.$suggestSolution        = "ddr_vref";
iEMIF1.vtp.$suggestSolution         = "ddr_vtp";
iGLUE1.$suggestSolution             = "GLUE";
iGPIO1["gpio[7]"].$suggestSolution  = "eCAP0_in_PWM0_out";
iGPIO1["gpio[12]"].$suggestSolution = "uart1_ctsn";
iGPIO1["gpio[13]"].$suggestSolution = "uart1_rtsn";
iGPIO1["gpio[26]"].$suggestSolution = "gpmc_ad10";
iGPIO1["gpio[27]"].$suggestSolution = "gpmc_ad11";
iGPIO1["gpio[30]"].$suggestSolution = "gpmc_wait0";
iGPIO1["gpio[31]"].$suggestSolution = "gpmc_wpn";
iGPIO2.$suggestSolution             = "GPIO1";
iGPIO2["gpio[8]"].$suggestSolution  = "uart0_ctsn";
iI2C1.SCL.$suggestSolution          = "I2C0_SCL";
iI2C1.SDA.$suggestSolution          = "I2C0_SDA";
iI2C2.SCL.$suggestSolution          = "spi0_cs0";
iI2C2.SDA.$suggestSolution          = "spi0_d1";
iMDIO1.$suggestSolution             = "MDIO";
iMDIO1.clk.$suggestSolution         = "mdio_clk";
iMDIO1.data.$suggestSolution        = "mdio_data";
iMII1.col.$suggestSolution          = "gmii1_col";
iMII1.crs.$suggestSolution          = "gmii1_crs";
iMII1.rxer.$suggestSolution         = "gmii1_rxer";
iMII1.txen.$suggestSolution         = "gmii1_txen";
iMII1.rxdv.$suggestSolution         = "gmii1_rxdv";
iMII1.txclk.$suggestSolution        = "gmii1_txclk";
iMII1.rxclk.$suggestSolution        = "gmii1_rxclk";
iMII1.txd0.$suggestSolution         = "gmii1_txd0";
iMII1.txd1.$suggestSolution         = "gmii1_txd1";
iMII1.txd2.$suggestSolution         = "gmii1_txd2";
iMII1.txd3.$suggestSolution         = "gmii1_txd3";
iMII1.rxd0.$suggestSolution         = "gmii1_rxd0";
iMII1.rxd1.$suggestSolution         = "gmii1_rxd1";
iMII1.rxd2.$suggestSolution         = "gmii1_rxd2";
iMII1.rxd3.$suggestSolution         = "gmii1_rxd3";
iMMC1.clk.$suggestSolution          = "gpmc_clk";
iMMC1.cmd.$suggestSolution          = "gpmc_csn3";
iMMC1.dat0.$suggestSolution         = "gpmc_ad12";
iMMC1.dat1.$suggestSolution         = "gpmc_ad13";
iMMC1.dat2.$suggestSolution         = "gpmc_ad14";
iMMC1.dat3.$suggestSolution         = "gpmc_ad15";
iMMC2.$suggestSolution              = "MMC1";
iMMC2.clk.$suggestSolution          = "gpmc_csn1";
iMMC2.cmd.$suggestSolution          = "gpmc_csn2";
iMMC2.dat0.$suggestSolution         = "gpmc_ad0";
iMMC2.dat1.$suggestSolution         = "gpmc_ad1";
iMMC2.dat2.$suggestSolution         = "gpmc_ad2";
iMMC2.dat3.$suggestSolution         = "gpmc_ad3";
iMMC2.dat4.$suggestSolution         = "gpmc_ad4";
iMMC2.dat5.$suggestSolution         = "gpmc_ad5";
iMMC2.dat6.$suggestSolution         = "gpmc_ad6";
iMMC2.dat7.$suggestSolution         = "gpmc_ad7";
iMMC3.clk.$suggestSolution          = "mmc0_clk";
iMMC3.cmd.$suggestSolution          = "mmc0_cmd";
iMMC3.dat1.$suggestSolution         = "mmc0_dat1";
iMMC3.dat2.$suggestSolution         = "mmc0_dat2";
iMMC3.dat3.$suggestSolution         = "mmc0_dat3";
iOSC1.IN.$suggestSolution           = "OSC1_IN";
iOSC1.OUT.$suggestSolution          = "OSC1_OUT";
iOSC2.$suggestSolution              = "OSC0";
iOSC2.IN.$suggestSolution           = "OSC0_IN";
iOSC2.OUT.$suggestSolution          = "OSC0_OUT";
iSPI1.SCLK.$suggestSolution         = "mcasp0_aclkx";
iSPI1.D0.$suggestSolution           = "mcasp0_fsx";
iSPI1.D1.$suggestSolution           = "mcasp0_axr0";
iUART1.rxd.$suggestSolution         = "uart0_rxd";
iUART1.txd.$suggestSolution         = "uart0_txd";
iUART2.rxd.$suggestSolution         = "uart1_rxd";
iUART2.txd.$suggestSolution         = "uart1_txd";
iUART3.rxd.$suggestSolution         = "spi0_sclk";
iUART3.txd.$suggestSolution         = "spi0_d0";
iUSB1.$suggestSolution              = "USB1";
iUSB1.CE.$suggestSolution           = "USB1_CE";
iUSB1.DM.$suggestSolution           = "USB1_DM";
iUSB1.DP.$suggestSolution           = "USB1_DP";
iUSB1.DRVVBUS.$suggestSolution      = "USB1_DRVVBUS";
iUSB1.ID.$suggestSolution           = "USB1_ID";
iUSB1.VBUS.$suggestSolution         = "USB1_VBUS";
iUSB2.$suggestSolution              = "USB0";
iUSB2.CE.$suggestSolution           = "USB0_CE";
iUSB2.DM.$suggestSolution           = "USB0_DM";
iUSB2.DP.$suggestSolution           = "USB0_DP";
iUSB2.DRVVBUS.$suggestSolution      = "USB0_DRVVBUS";
iUSB2.ID.$suggestSolution           = "USB0_ID";
iUSB2.VBUS.$suggestSolution         = "USB0_VBUS";
